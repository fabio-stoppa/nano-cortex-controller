## components/nano/Kconfig.projbuild
```kconfig
menu "Nano Cortex firmware"

config NANO_LOG_TUNER_ONLY
    bool "Serial: only nano_tuner INFO logs (suppress other INFO)"
    default n
    help
        Lowers the default log level for all tags to WARN, then re-enables
        INFO for the nano_tuner tag only. Warnings and errors still print.

config NANO_LOG_QUIET
    bool "Serial: quiet routine BLE/state INFO (keep FX Amount / focus)"
    default n
    help
        Sets nano_state and nano_ble tags to WARN so ROUTINE preset dumps,
        amp lines, and BLE chatter stay off the console. nano_fx INFO remains
        (Amount knob + pedal FX focus). Warnings and errors still print.

endmenu
```

## components/waveshare_esp32_s3_touch_lcd_4_3/Kconfig
```kconfig
menu "Waveshare: ESP32 S3 Touch LCD 4.3 (A) Configuration"
    menu "LCD"
        config LCD_RGB_BOUNCE_BUFFER_HEIGHT
            int "RGB Bounce buffer height"
            default 10
            help
                Height of bounce buffer. The width of the buffer is the same as that of the LCD.

    endmenu

    menu "LVGL"
        config LVGL_PORT_TASK_MAX_DELAY_MS
            int "LVGL timer task maximum delay (ms)"
            default 500
            range 2 2000  # Example range, adjust as needed
            help
            The maximum delay of the LVGL timer task, in milliseconds.

        config LVGL_PORT_TASK_MIN_DELAY_MS
            int "LVGL timer task minimum delay (ms)"
            default 10
            range 1 100  # Example range, adjust as needed
            help
            The minimum delay of the LVGL timer task, in milliseconds.

        config LVGL_PORT_TASK_PRIORITY
            int "LVGL task priority"
            default 2
            help
                The Board Support Package will create a task that will periodically handle LVGL operation in lv_timer_handler().

        config LVGL_PORT_TASK_STACK_SIZE_KB
            int "LVGL task stack size (KB)"
            default 16
            help
                Size(KB) of LVGL task stack.

        config LVGL_PORT_TASK_CORE
            int "LVGL timer task core"
            default -1
            range -1 1
            help
            The core of the LVGL timer task.
            Set to -1 to not specify the core.
            Set to 1 only if the SoCs support dual-core, otherwise set to -1 or 0.

        config LVGL_PORT_TICK
            int "LVGL tick period"
            default 2
            range 1 100
            help
                Period of LVGL tick timer.

        config LVGL_PORT_AVOID_TEAR_ENABLE
            bool "Avoid tearing effect"
            default "n"
            help
                Avoid tearing effect through LVGL buffer mode and double frame buffers of RGB LCD. This feature is only available for RGB LCD.

        choice
            depends on LVGL_PORT_AVOID_TEAR_ENABLE
            prompt "Select Avoid Tearing Mode"
            default LVGL_PORT_AVOID_TEAR_MODE_3
            config LVGL_PORT_AVOID_TEAR_MODE_1
                bool "Mode1: LCD double-buffer & LVGL full-refresh"
            config LVGL_PORT_AVOID_TEAR_MODE_2
                bool "Mode2: LCD triple-buffer & LVGL full-refresh"
            config LVGL_PORT_AVOID_TEAR_MODE_3
                bool "Mode3: LCD double-buffer & LVGL direct-mode"
            help
                The current tearing prevention mode supports both full refresh mode and direct mode. Tearing prevention mode may consume more PSRAM space
        endchoice

        config LVGL_PORT_AVOID_TEAR_MODE
            depends on LVGL_PORT_AVOID_TEAR_ENABLE
            int
            default 1 if LVGL_PORT_AVOID_TEAR_MODE_1
            default 2 if LVGL_PORT_AVOID_TEAR_MODE_2
            default 3 if LVGL_PORT_AVOID_TEAR_MODE_3

        choice
            depends on LVGL_PORT_AVOID_TEAR_ENABLE
            prompt "Select rotation"
            default LVGL_PORT_ROTATION_0
            config LVGL_PORT_ROTATION_0
                bool "Rotation 0"
            config LVGL_PORT_ROTATION_90
                bool "Rotation 90"
            config LVGL_PORT_ROTATION_180
                bool "Rotation 180"
            config LVGL_PORT_ROTATION_270
                bool "Rotation 270"
        endchoice

        config LVGL_PORT_ROTATION_DEGREE
            int
            default 0 if LVGL_PORT_ROTATION_0
            default 90 if LVGL_PORT_ROTATION_90
            default 180 if LVGL_PORT_ROTATION_180
            default 270 if LVGL_PORT_ROTATION_270

        choice
            depends on !LVGL_PORT_AVOID_TEAR_ENABLE
            prompt "Select LVGL buffer memory capability"
            default LVGL_PORT_BUF_INTERNAL
            config LVGL_PORT_BUF_PSRAM
                bool "PSRAM memory"
            config LVGL_PORT_BUF_INTERNAL
                bool "Internal memory"
        endchoice

        config LVGL_PORT_BUF_HEIGHT
            depends on !LVGL_PORT_AVOID_TEAR_ENABLE
            int "LVGL buffer height"
            default 100
            help
                Height of LVGL buffer. The width of the buffer is the same as that of the LCD.
    endmenu
endmenu
```
